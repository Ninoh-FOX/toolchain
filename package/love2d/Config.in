## package/love2d/Config.in
```kconfig
config BR2_PACKAGE_LOVE2D
	bool "Love2D"
	depends on BR2_PACKAGE_HAS_LIBGLES
	depends on BR2_PACKAGE_HAS_LUAINTERPRETER
	select BR2_PACKAGE_DEVIL
	select BR2_PACKAGE_LIBMODPLUG
	select BR2_PACKAGE_LIBVORBIS
	select BR2_PACKAGE_SDL2
	help
	  Framework for making 2D games in Lua

	  https://love2d.org
```

## package/mikmod/Config.in
```kconfig
config BR2_PACKAGE_MIKMOD
	bool "mikmod"
	help
	  libmikmod is a library supporting many formats, including s3m, it, xm,
	  and several others. Mikmod is a module player based on libmikmod.

	  http://mikmod.sourceforge.net/
	  https://sourceforge.net/projects/mikmod/
```

## package/modplugtools/Config.in
```kconfig
config BR2_PACKAGE_MODPLUGTOOLS
	bool "modplugtools"
	help
	  Simple command line tools to play music files using libmodplug.

	  http://modplug-xmms.sourceforge.net/
```

## package/mono/Config.in
```kconfig
config BR2_PACKAGE_MONO
	bool "mono"
	select BR2_PACKAGE_ZLIB
	help
	  An open-source, cross-platform implementation of C#

	  http://mono-project.com
```

## package/ncurses5/Config.in
```kconfig
config BR2_PACKAGE_NCURSES5
	bool "ncurses5"
	help
	  The Ncurses (new curses) library is a free software emulation of
	  curses in System V Release 4.0, and more.

	  This package installs only a few vital termcap entries

	  http://www.gnu.org/software/ncurses/

if BR2_PACKAGE_NCURSES5

config BR2_PACKAGE_NCURSES5_WCHAR
	bool "enable wide char support"
	depends on BR2_USE_WCHAR
	help
	  Enable wide char & UTF-8 support in ncurses libraries

config BR2_PACKAGE_NCURSES5_TARGET_PANEL
	bool "ncurses libpanel in target"
	help
	  Includes ncurses dynamic libpanel in target

config BR2_PACKAGE_NCURSES5_TARGET_FORM
	bool "ncurses libform in target"
	help
	  Includes ncurses dynamic libform in target

config BR2_PACKAGE_NCURSES5_TARGET_MENU
	bool "ncurses libmenu in target"
	help
	  Includes ncurses dynamic libmenu in target
	  
config BR2_PACKAGE_NCURSES5_ADDITIONAL_TERMINFO
	string "additional terminfo files to install"
	help
	  Whitespace separated list of terminfo files to install on the
	  target. A small number of vital terminfo files are always
	  installed. This list is in addition to the vital ones.

config BR2_PACKAGE_NCURSES5_TARGET_PROGS
	bool "ncurses programs"
	help
	  Include ncurses programs in traget (clear, reset, tput, ...)

endif
```

## package/ncursesw/Config.in
```kconfig
config BR2_PACKAGE_NCURSESW
	bool "ncursesw"
	help
	  The Ncurses (new curses) library is a free software emulation of
	  curses in System V Release 4.0, and more.

	  This package installs only a few vital termcap entries

	  http://deb.debian.org/debian/pool/main/n/ncurses

if BR2_PACKAGE_NCURSESW

config BR2_PACKAGE_NCURSESW_TARGET_PANEL
	bool "ncurses libpanel in target"
	help
	  Includes ncurses dynamic libpanel in target

config BR2_PACKAGE_NCURSESW_TARGET_FORM
	bool "ncurses libform in target"
	help
	  Includes ncurses dynamic libform in target

config BR2_PACKAGE_NCURSESW_TARGET_MENU
	bool "ncurses libmenu in target"
	help
	  Includes ncurses dynamic libmenu in target
	  
config BR2_PACKAGE_NCURSESW_ADDITIONAL_TERMINFO
	string "additional terminfo files to install"
	help
	  Whitespace separated list of terminfo files to install on the
	  target. A small number of vital terminfo files are always
	  installed. This list is in addition to the vital ones.

config BR2_PACKAGE_NCURSESW_TARGET_PROGS
	bool "ncurses programs"
	help
	  Include ncurses programs in traget (clear, reset, tput, ...)

endif
```

## package/o2xiv/Config.in
```kconfig
config BR2_PACKAGE_O2XIV
	bool "o2xiv"
	select BR2_PACKAGE_JPEG
	select BR2_PACKAGE_SDL
	select BR2_PACKAGE_SDL_IMAGE
	help
	  Simple image viewer using SDL

	  http://www.intoorbit.org/projects/o2xiv
```

## package/od-network-config/Config.in
```kconfig
config BR2_PACKAGE_OD_NETWORK_CONFIG
	bool "OpenDingux network configuration GUI"
	depends on BR2_PACKAGE_PYTHON_PYGAME
	select BR2_PACKAGE_PYTHON_PYGAME_FONT
	help
	  This small application lets the user configure networking on
	  OpenDingux based systems.
```

## package/openal-soft/Config.in
```kconfig
config BR2_PACKAGE_OPENAL_SOFT
	bool "openal-soft"
	help
	  OpenAL Soft is a software implementation of the OpenAL 3D audio API.

	  http://sourceforge.net/projects/openal-soft/
```

## package/p7zip/Config.in
```kconfig
config BR2_PACKAGE_P7ZIP
	bool "p7zip"
	help
	  Command line (de)compression tool for 7z archives.

	  Only the "7zr" tool is built, which is sufficient to handle 7z
	  archives, but doesn't support all the other compression formats
	  that the full 7-Zip and p7zip packages do.

	  http://p7zip.sourceforge.net/
```

## package/physfs/Config.in
```kconfig
config BR2_PACKAGE_PHYSFS
	bool "libphysfs"
	select BR2_PACKAGE_ZLIB
	help
	  PhysicsFS is a library to provide abstract access to various archives.

	  https://icculus.org/physfs/
```

## package/python-mako/Config.in
```kconfig
config BR2_PACKAGE_PYTHON_MAKO
	bool "python-mako"
	help
	  Mako is a template library written in Python. It provides a
	  familiar, non-XML syntax which compiles into Python modules
	  for maximum performance.

	  https://pypi.python.org/pypi/Mako
	  
config BR2_PACKAGE_HOST_PYTHON_MAKO
	bool "host-python-mako"
	select BR2_PACKAGE_HOST_PYTHON_MARKUPSAFE
	help
	  Mako is a template library written in Python. It provides a
	  familiar, non-XML syntax which compiles into Python modules
	  for maximum performance.

	  https://pypi.python.org/pypi/Mako
```

## package/python-markupsafe/Config.in
```kconfig
config BR2_PACKAGE_PYTHON_MARKUPSAFE
	bool "python-markupsafe"
	help
	  MarkupSafe implements a XML/HTML/XHTML Markup safe string
	  for Python.

	  https://github.com/mitsuhiko/markupsafe

config BR2_PACKAGE_HOST_PYTHON_MARKUPSAFE
	bool "host-python-markupsafe"
	help
	  MarkupSafe implements a XML/HTML/XHTML Markup safe string
	  for Python.

	  https://github.com/mitsuhiko/markupsafe
```

## package/python3-setuptools/Config.in
```kconfig
config BR2_PACKAGE_PYTHON3_SETUPTOOLS
	bool "python3-setuptools"
	depends on BR2_PACKAGE_PYTHON3
	select BR2_PACKAGE_PYTHON_ZLIB
	help
	  Download, build, install, upgrade, and uninstall Python packages.

	  http://pypi.python.org/pypi/setuptools
```

## package/sdl2_net/Config.in
```kconfig
config BR2_PACKAGE_SDL2_NET
	bool "SDL2_net"
	depends on BR2_PACKAGE_SDL2
	help
	  SDL2_net is a small, low-level, cross-platform network library, that
	  can be used with the Simple DirectMedia Layer library (SDL2).

	  http://www.libsdl.org/projects/SDL_net/
```

## package/sdl_compat/Config.in
```kconfig
config BR2_PACKAGE_SDL_COMPAT
	bool "SDL_COMPAT"
	help
	  Simple DirectMedia Layer - SDL is a library that allows
	  programs portable low level access to a video framebuffer,
	  audio output, mouse, and keyboard.

	  http://www.libsdl.org/
```

## package/sdl_gpu/Config.in
```kconfig
config BR2_PACKAGE_SDL_GPU
	bool "sdl_gpu"
	help
		SDL_gpu, a library for making hardware-accelerated 2D graphics easy. by Jonathan Dearborn
		SDL_gpu is licensed under the terms of the MIT License. See LICENSE.txt for details of the usage license granted to you for this code.
		High performance (it automatically collects and submits batches instead of separate draw commands for each sprite and redundant state changes)
		Shader API
		Arbitrary geometry rendering (triangles)
		Can be integrated with explicit OpenGL calls (mixed 2D and 3D)
		Full blend state control
		Built-in primitive shapes (points, lines, tris, rects, ellipses, polygons, even arcs)
		Uses a style familiar to SDL 1.2 users
		Compatible with either SDL 1.2 or 2.0
		Loads BMP, TGA, and PNG files via stb-image
		Rotates and scales about the center of images, making reasoning about the resulting corner coordinates more obvious (adjustable via anchor settings)
		
		https://github.com/grimfang4/sdl-gpu
```

## package/timidity-instruments/Config.in
```kconfig
config BR2_PACKAGE_TIMIDITY_INSTRUMENTS
	bool "Timidity instruments"
	help
	  Set of Gravis Ultrasound compatible instrument patches to use
	  with timidity.
```

## package/unrar/Config.in
```kconfig
config BR2_PACKAGE_UNRAR
	bool "unrar"
	help
	  Extractor for packages in RAR format.

	  http://www.rarlabs.com/

if BR2_PACKAGE_UNRAR

config BR2_PACKAGE_UNRAR_SMP
	bool "Use thread pool for extraction"
	depends on !BR2_PTHREADS_NONE
	default y
	help
	  Uncheck this option to disable the thread pool mechanism.
	  This can save some space when you're building for a single core system.

endif # BR2_PACKAGE_UNRAR
```
