## board/opendingux/Config.in
```kconfig
menu "OpenDingux packages"
	source "$BR2_EXTERNAL/package/allegro/Config.in"
	source "$BR2_EXTERNAL/package/gmenu2x/Config.in"
	source "$BR2_EXTERNAL/package/gmenunx/Config.in"
	source "$BR2_EXTERNAL/package/gng/Config.in"
	source "$BR2_EXTERNAL/package/hocoslamfy/Config.in"
	source "$BR2_EXTERNAL/package/libini/Config.in"
	source "$BR2_EXTERNAL/package/libopk/Config.in"
	source "$BR2_EXTERNAL/package/libshake/Config.in"
	source "$BR2_EXTERNAL/package/libxdgmime/Config.in"
	source "$BR2_EXTERNAL/package/love2d/Config.in"
	source "$BR2_EXTERNAL/package/od-network-config/Config.in"
	source "$BR2_EXTERNAL/package/pwswd/Config.in"
endmenu
```

## board/opendingux/package/allegro/Config.in
```kconfig
config BR2_PACKAGE_ALLEGRO
	bool "allegro"
	select BR2_PACKAGE_ALSA_LIB
	select BR2_PACKAGE_ZLIB
	select BR2_PACKAGE_LIBPNG
	select BR2_PACKAGE_LIBOGG
	select BR2_PACKAGE_LIBVORBIS
	help
	  Allegro 4.4.2 is cross-platform multimedia library targeted
	  at creating games. It provides routines for video, audio
	  mouse, and keyboard.

	  http://alleg.sourceforge.net/

if BR2_PACKAGE_ALLEGRO

config BR2_PACKAGE_ALLEGRO_FBCON
	bool "Allegro framebuffer console video driver"
	default y

config BR2_PACKAGE_ALLEGRO_X11
	bool "Allegro X11 video driver"
	depends on BR2_PACKAGE_XORG7
	select BR2_PACKAGE_XLIB_LIBX11
	select BR2_PACKAGE_XLIB_LIBXEXT

endif
```

## board/opendingux/package/gng/Config.in
```kconfig
config BR2_PACKAGE_GNG
	bool "gng"
	depends on BR2_PACKAGE_ALLEGRO
	help
	  Ghouls 'n Ghosts Remix
```

## configs/playgov2_defconfig
```kconfig
BR2_mipsel=y
BR2_mips_32r2=y
# BR2_MIPS_SOFT_FLOAT is not set
BR2_OPTIMIZE_2=y
BR2_TOOLCHAIN_BUILDROOT_VENDOR="gcw0"
BR2_KERNEL_HEADERS_3_19=y
BR2_UCLIBC_CONFIG="board/opendingux/pg2v2/uclibc.config"
BR2_TOOLCHAIN_BUILDROOT_LARGEFILE=y
BR2_TOOLCHAIN_BUILDROOT_INET_IPV6=y
BR2_TOOLCHAIN_BUILDROOT_WCHAR=y
BR2_PTHREAD_DEBUG=y
BR2_BINUTILS_EXTRA_CONFIG_OPTIONS="--enable-lto"
BR2_GCC_VERSION_4_9_X=y
BR2_EXTRA_GCC_CONFIG_OPTIONS="--enable-lto"
BR2_TOOLCHAIN_BUILDROOT_CXX=y
BR2_GCC_ENABLE_GRAPHITE=y
BR2_PACKAGE_HOST_GDB=y
BR2_GDB_VERSION_7_7=y
BR2_TARGET_GENERIC_HOSTNAME="PLAYGOV2"
BR2_TARGET_GENERIC_ISSUE="Welcome to ROGUE resistance"
BR2_ROOTFS_DEVICE_CREATION_DYNAMIC_EUDEV=y
BR2_ROOTFS_SKELETON_CUSTOM=y
BR2_ROOTFS_SKELETON_CUSTOM_PATH="board/opendingux/pg2v2/target_skeleton"
BR2_TARGET_TZ_INFO=y
BR2_ROOTFS_POST_BUILD_SCRIPT="board/opendingux/pg2v2/post-build-script.sh"
BR2_LINUX_KERNEL=y
BR2_LINUX_KERNEL_CUSTOM_GIT=y
BR2_LINUX_KERNEL_CUSTOM_REPO_URL="https://github.com/Ninoh-FOX/POCKETGO2V2_KERNEL"
BR2_LINUX_KERNEL_CUSTOM_REPO_VERSION="master"
BR2_LINUX_KERNEL_USE_CUSTOM_CONFIG=y
BR2_LINUX_KERNEL_CUSTOM_CONFIG_FILE="board/kernel/pgv2/pgv2_linux.config"
BR2_LINUX_KERNEL_VMLINUZ_BIN=y
BR2_PACKAGE_BUSYBOX_CONFIG="board/opendingux/busybox-1.20.x.config"
BR2_PACKAGE_BUSYBOX_SHOW_OTHERS=y
BR2_PACKAGE_ALSA_UTILS_ALSACTL=y
BR2_PACKAGE_ALSA_UTILS_ALSACONF=y
BR2_PACKAGE_ALSA_UTILS=y
BR2_PACKAGE_ALSA_UTILS_AMIDI=y
BR2_PACKAGE_ALSA_UTILS_AMIXER=y
BR2_PACKAGE_ALSA_UTILS_APLAY=y
BR2_PACKAGE_ALSA_UTILS_ACONNECT=y
BR2_PACKAGE_ALSA_UTILS_APLAYMIDI=y
BR2_PACKAGE_ALSA_UTILS_ARECORDMIDI=y
BR2_PACKAGE_ALSA_UTILS_ASEQDUMP=y
BR2_PACKAGE_ALSA_UTILS_ASEQNET=y
BR2_PACKAGE_ALSA_VOLUME=y
BR2_PACKAGE_ALSA_LIB=y
BR2_PACKAGE_ALSA_LIB_PCM_PLUGINS=y
BR2_PACKAGE_ALSA_LIB_CTL_PLUGINS=y
BR2_PACKAGE_ALSA_LIB_PCM=y
BR2_PACKAGE_ALSA_LIB_MIXER=y
BR2_PACKAGE_FLAC=y
BR2_PACKAGE_MODPLUGTOOLS=y
BR2_PACKAGE_OPENAL_SOFT=y
BR2_PACKAGE_P7ZIP=y
BR2_PACKAGE_UNRAR=y
# BR2_PACKAGE_UNRAR_SMP is not set
BR2_PACKAGE_DMALLOC=y
BR2_PACKAGE_DSTAT=y
BR2_PACKAGE_GDB=y
BR2_PACKAGE_GDB_SERVER=y
BR2_PACKAGE_GDB_DEBUGGER=y
BR2_PACKAGE_MEMSTAT=y
BR2_PACKAGE_OPROFILE=y
BR2_PACKAGE_STRACE=y
BR2_PACKAGE_STRESS=y
BR2_PACKAGE_BINUTILS_TARGET=y
BR2_PACKAGE_LIBTOOL=y
BR2_PACKAGE_OPKG=y
BR2_PACKAGE_SSTRIP=y
BR2_PACKAGE_DOSFSTOOLS=y
BR2_PACKAGE_DOSFSTOOLS_MKFS_FAT=y
BR2_PACKAGE_DOSFSTOOLS_FSCK_FAT=y
BR2_PACKAGE_E2FSPROGS=y
# BR2_PACKAGE_E2FSPROGS_CHATTR is not set
# BR2_PACKAGE_E2FSPROGS_DUMPE2FS is not set
# BR2_PACKAGE_E2FSPROGS_E2FREEFRAG is not set
# BR2_PACKAGE_E2FSPROGS_E2UNDO is not set
# BR2_PACKAGE_E2FSPROGS_FILEFRAG is not set
# BR2_PACKAGE_E2FSPROGS_FINDFS is not set
BR2_PACKAGE_E2FSPROGS_FSCK=y
# BR2_PACKAGE_E2FSPROGS_LOGSAVE is not set
# BR2_PACKAGE_E2FSPROGS_LSATTR is not set
# BR2_PACKAGE_E2FSPROGS_MKLOSTFOUND is not set
BR2_PACKAGE_E2FSPROGS_RESIZE2FS=y
# BR2_PACKAGE_E2FSPROGS_UUIDGEN is not set
BR2_PACKAGE_EXFAT=y
BR2_PACKAGE_EXFAT_UTILS=y
BR2_PACKAGE_NTFS_3G=y
BR2_PACKAGE_O2XIV=y
BR2_PACKAGE_ALLEGRO=y
BR2_PACKAGE_BENNUGD=y
BR2_PACKAGE_FBGRAB=y
BR2_PACKAGE_LOVE2D=y
BR2_PACKAGE_SDL=y
# BR2_PACKAGE_SDL_COMPAT is not set
BR2_PACKAGE_SDL_GFX=y
BR2_PACKAGE_SDL_GPU=y
BR2_PACKAGE_SDL_IMAGE_GIF=y
BR2_PACKAGE_SDL_IMAGE_TARGA=y
BR2_PACKAGE_SDL_IMAGE_XPM=y
BR2_PACKAGE_SDL_NET=y
BR2_PACKAGE_SDL_SOUND=y
BR2_PACKAGE_SDL2=y
BR2_PACKAGE_SDL2_GFX=y
BR2_PACKAGE_SDL2_IMAGE=y
BR2_PACKAGE_SDL2_IMAGE_GIF=y
BR2_PACKAGE_SDL2_IMAGE_JPEG=y
BR2_PACKAGE_SDL2_IMAGE_PNG=y
BR2_PACKAGE_SDL2_IMAGE_XPM=y
BR2_PACKAGE_SDL2_MIXER=y
BR2_PACKAGE_SDL2_NET=y
BR2_PACKAGE_SDL2_TTF=y
BR2_PACKAGE_SDL2_OPENGLES=y
BR2_PACKAGE_SDL2_KMSDRM=y
BR2_PACKAGE_TIMIDITY_INSTRUMENTS=y
BR2_PACKAGE_UNLOCKVT=y
BR2_PACKAGE_APITRACE=y
BR2_PACKAGE_LINUX_FIRMWARE=y
# BR2_PACKAGE_LINUX_FIRMWARE_RTL_81XX is not set
BR2_PACKAGE_EVTEST=y
BR2_PACKAGE_FMTOOLS=y
BR2_PACKAGE_I2C_TOOLS=y
BR2_PACKAGE_LINUX_CONSOLE_TOOLS=y
BR2_PACKAGE_LINUX_CONSOLE_TOOLS_JOY=y
BR2_PACKAGE_LINUX_CONSOLE_TOOLS_FF=y
BR2_PACKAGE_LOWPOWD=y
BR2_PACKAGE_PWSWD=y
BR2_PACKAGE_PWSWD_PLATFORM="pg2v2"
BR2_PACKAGE_LIBSHAKE=y
BR2_PACKAGE_LIBSHAKE_PLATFORM="gcw0"
BR2_PACKAGE_LIBSHAKE2=y
BR2_PACKAGE_LIBSHAKE2_PLATFORM="gcw0"
BR2_PACKAGE_JAMVM=y
BR2_PACKAGE_LUAJIT=y
BR2_PACKAGE_NODEJS=y
BR2_PACKAGE_PYTHON=y
BR2_PACKAGE_PYTHON_CURSES=y
BR2_PACKAGE_PYTHON_PYEXPAT=y
BR2_PACKAGE_PYTHON_READLINE=y
# BR2_PACKAGE_PYTHON_UNICODEDATA is not set
BR2_PACKAGE_PYTHON_SQLITE=y
BR2_PACKAGE_PYTHON_ZLIB=y
BR2_PACKAGE_PYTHON_PYGAME=y
BR2_PACKAGE_PYTHON_PYGAME_IMAGE=y
BR2_PACKAGE_PYTHON_PYGAME_MIXER_MUSIC=y
BR2_PACKAGE_PYTHON_PYGAME_MIXER=y
BR2_PACKAGE_PYTHON_SCANDIR=y
BR2_PACKAGE_HOST_PYTHON_MAKO=y
BR2_PACKAGE_HOST_PYTHON_CYTHON=y
# BR2_PACKAGE_ALSA_LIB_ALISP is not set
# BR2_PACKAGE_ALSA_LIB_OLD_SYMBOLS is not set
BR2_PACKAGE_FLUIDSYNTH=y
BR2_PACKAGE_LIBINI=y
BR2_PACKAGE_LIBAO=y
BR2_PACKAGE_LIBC=y
BR2_PACKAGE_LIBASPLIB=y
BR2_PACKAGE_LIBID3TAG=y
BR2_PACKAGE_LIBMAD=y
BR2_PACKAGE_LIBMAD_OPTIMIZATION_SPEED=y
BR2_PACKAGE_LIBMAD_SSO=y
BR2_PACKAGE_LIBMAD_ASO=y
BR2_PACKAGE_LIBMODPLUG=y
BR2_PACKAGE_LIBVORBIS=y
BR2_PACKAGE_LIBZIP=y
BR2_PACKAGE_LIBSHA1=y
BR2_PACKAGE_LIBCONFIG=y
BR2_PACKAGE_LIBHUGETLBFS=y
BR2_PACKAGE_LIGHTNING=y
BR2_PACKAGE_LIGHTREC=y
BR2_PACKAGE_JPEG_TURBO=y
BR2_PACKAGE_LIBPNG16=y
BR2_PACKAGE_LIBPTHREAD_STUBS=y
BR2_PACKAGE_LIBSIGC=y
BR2_PACKAGE_LIBMIKMOD=y
BR2_PACKAGE_LIBSNDFILE=y
BR2_PACKAGE_SPEEX=y
BR2_PACKAGE_TAGLIB=y
BR2_PACKAGE_TREMOR=y
BR2_PACKAGE_PHYSFS=y
BR2_PACKAGE_LIBCONFUSE=y
BR2_PACKAGE_LIBOPK=y
BR2_PACKAGE_LIBSYSFS=y
BR2_PACKAGE_ETNA_VIV=y
BR2_PACKAGE_ETNA_VIV_ABIV4=y
BR2_PACKAGE_LIBUNGIF=y
BR2_PACKAGE_MESA3D_ETNA_VIV=y
BR2_PACKAGE_MESA3D_ETNA_VIV_VG=y
BR2_PACKAGE_LIBDRM=y
BR2_PACKAGE_LIBDRM_HAS_ATOMIC=y
BR2_PACKAGE_LIBDRM_ENABLE_ATOMIC=y
BR2_PACKAGE_LIBDRM_ETNAVIV=y
BR2_PACKAGE_LIBGBM=y
BR2_PACKAGE_LIBAIO=y
BR2_PACKAGE_TSLIB=y
BR2_PACKAGE_LIBTHEORA=y
BR2_PACKAGE_MPG123=y
BR2_PACKAGE_BOOST=y
BR2_PACKAGE_BOOST_STATIC=y
BR2_PACKAGE_BOOST_CHRONO=y
BR2_PACKAGE_BOOST_DATE_TIME=y
BR2_PACKAGE_BOOST_EXCEPTION=y
BR2_PACKAGE_BOOST_FILESYSTEM=y
BR2_PACKAGE_BOOST_GRAPH=y
BR2_PACKAGE_BOOST_IOSTREAMS=y
BR2_PACKAGE_BOOST_LOCALE=y
BR2_PACKAGE_BOOST_MATH=y
BR2_PACKAGE_BOOST_PROGRAM_OPTIONS=y
BR2_PACKAGE_BOOST_RANDOM=y
BR2_PACKAGE_BOOST_REGEX=y
BR2_PACKAGE_BOOST_SERIALIZATION=y
BR2_PACKAGE_BOOST_SIGNALS=y
BR2_PACKAGE_BOOST_SYSTEM=y
BR2_PACKAGE_BOOST_THREAD=y
BR2_PACKAGE_BOOST_TIMER=y
BR2_PACKAGE_GLM=y
BR2_PACKAGE_NCURSES_ADDITIONAL_TERMINFO="s/st-256color"
BR2_PACKAGE_NCURSES=y
BR2_PACKAGE_NCURSES5=y
BR2_PACKAGE_NCURSES_TARGET_PANEL=y
BR2_PACKAGE_NCURSES_TARGET_FORM=y
BR2_PACKAGE_NCURSES_TARGET_MENU=y
BR2_PACKAGE_NCURSES5_TARGET_PANEL=y
BR2_PACKAGE_NCURSES5_TARGET_FORM=y
BR2_PACKAGE_NCURSES5_TARGET_MENU=y
BR2_PACKAGE_NCURSESW=y
BR2_PACKAGE_NCURSESW5=y
BR2_PACKAGE_NCURSESW_TARGET_PANEL=y
BR2_PACKAGE_NCURSESW_TARGET_FORM=y
BR2_PACKAGE_NCURSESW_TARGET_MENU=y
BR2_PACKAGE_NCURSESW5_TARGET_PANEL=y
BR2_PACKAGE_NCURSESW5_TARGET_FORM=y
BR2_PACKAGE_NCURSESW5_TARGET_MENU=y
BR2_PACKAGE_LIBXDGMIME=y
BR2_PACKAGE_GMENU2X=y
BR2_PACKAGE_GMENU2X_PLATFORM="gcw0"
BR2_PACKAGE_GMENU2X_STICK="yes"
BR2_PACKAGE_GMENU2X_BATTERY="pg2v2"
# BR2_PACKAGE_GCW_CONNECT is not set
BR2_PACKAGE_AVAHI=y
BR2_PACKAGE_AVAHI_DAEMON=y
BR2_PACKAGE_BWM_NG=y
BR2_PACKAGE_DHCPDUMP=y
BR2_PACKAGE_DROPBEAR=y
BR2_PACKAGE_DROPBEAR_DISABLE_REVERSEDNS=y
# BR2_PACKAGE_DROPBEAR_SMALL is not set
BR2_PACKAGE_HOSTAPD=y
BR2_PACKAGE_HOSTAPD_EAP=y
BR2_PACKAGE_HOSTAPD_WPS=y
BR2_PACKAGE_IW=y
BR2_PACKAGE_NETCAT=y
BR2_PACKAGE_NTP=y
BR2_PACKAGE_NTP_NTPDATE=y
BR2_PACKAGE_NTP_NTPDC=y
BR2_PACKAGE_NTP_NTPQ=y
BR2_PACKAGE_NTP_TICKADJ=y
BR2_PACKAGE_OD_NETWORK_CONFIG=y
BR2_PACKAGE_OPENSSH=y
BR2_PACKAGE_NSS_MDNS=y
BR2_PACKAGE_RSYNC=y
BR2_PACKAGE_TCPDUMP=y
BR2_PACKAGE_USHARE=y
BR2_PACKAGE_VSFTPD=y
# BR2_PACKAGE_WGET is no set
# BR2_PACKAGE_WIRELESS_TOOLS is not set
# BR2_PACKAGE_WPA_SUPPLICANT is not set
# BR2_PACKAGE_WPA_SUPPLICANT_AP_SUPPORT is not set
# BR2_PACKAGE_WPA_SUPPLICANT_WPS is not set
# BR2_PACKAGE_WPA_SUPPLICANT_CLI= is not set
# BR2_PACKAGE_WPA_SUPPLICANT_PASSPHRASE= is no set
BR2_PACKAGE_XINETD=y
BR2_PACKAGE_BAR=y
BR2_PACKAGE_DIALOG=y
BR2_PACKAGE_PV=y
BR2_PACKAGE_DEVIL=y
BR2_PACKAGE_FILE=y
BR2_PACKAGE_LOCKFILE_PROGS=y
BR2_PACKAGE_SCREEN=y
BR2_PACKAGE_DINGUX_COMMANDER=y
BR2_PACKAGE_DINGUX_COMMANDER_TARGET_PLATFORM="rg350"
BR2_PACKAGE_GOOGLEFONTDIRECTORY=y
BR2_PACKAGE_HTOP=y
BR2_PACKAGE_KMOD_TOOLS=y
BR2_PACKAGE_UTIL_LINUX_BINARIES=y
BR2_PACKAGE_UTIL_LINUX_PARTX=y
BR2_PACKAGE_NANO=y
BR2_TARGET_ROOTFS_SQUASHFS=y
# BR2_TARGET_ROOTFS_TAR is not set
BR2_TARGET_UBIBOOT=y
BR2_TARGET_UBIBOOT_BOARDNAME="gcw0"
BR2_PACKAGE_HOST_GENIMAGE=y
```

## package/alsa-volume/Config.in
```kconfig
config BR2_PACKAGE_ALSA_VOLUME
	bool "alsa-volume"
	select BR2_PACKAGE_ALSA_LIB
	help
	  Small command line utilities to get and set ALSA mixer volume.

	  https://github.com/opendingux/alsa-volume
```

## package/apitrace/Config.in
```kconfig
comment "apitrace needs a toolchain w/ C++"
	depends on !BR2_INSTALL_LIBSTDCPP

config BR2_PACKAGE_APITRACE
	bool "apitrace"
	depends on BR2_INSTALL_LIBSTDCPP
	select BR2_PACKAGE_POPT
	select BR2_PACKAGE_BINUTILS
	help
	  Trace and replay OpenGL and OpenGL ES APIs calls to/from a
	  file. You may install apitrace GUI from your distribution to
	  inspect generated traces.

	  http://apitrace.github.io/
```

## package/bar/Config.in
```kconfig
config BR2_PACKAGE_BAR
	bool "bar"
	help
	  ‘cat’ with ASCII progress bar

	  http://www.theiling.de/projects/bar.html
```

## package/bennugd/Config.in
```kconfig
config BR2_PACKAGE_BENNUGD
	bool "bennugd"
        select BR2_PACKAGE_ZLIB
	select BR2_PACKAGE_LIBPNG
        select BR2_PACKAGE_SDL
        select BR2_PACKAGE_SDL_MIXER
        select BR2_PACKAGE_OPENSSL
	help
	  - Bennu Game Development -
          Bennu is a high level open source game development suite
          which focuses on modularity and portability,
          making it a perfect choice for cross-platform game development.

	  http://www.bennugd.org
```

## package/dingux-commander/Config.in
```kconfig
config BR2_PACKAGE_DINGUX_COMMANDER
	bool "DinguxCommander"
	select BR2_PACKAGE_SDL
	select BR2_PACKAGE_SDL2
	select BR2_PACKAGE_SDL_GFX
	select BR2_PACKAGE_SDL2_GFX
	select BR2_PACKAGE_SDL_IMAGE
	select BR2_PACKAGE_SDL_TTF
	select BR2_PACKAGE_GOOGLEFONTDIRECTORY
	select BR2_PACKAGE_DEJAVU
	help
	  Two-pane file manager in the style of Norton Commander.

	  http://beyondds.free.fr/index.php?Dingoo-dinguxcommander

if BR2_PACKAGE_DINGUX_COMMANDER

config BR2_PACKAGE_DINGUX_COMMANDER_TARGET_PLATFORM
	string "Target platform"
	
endif
```

## package/etna_viv/Config.in
```kconfig
config BR2_PACKAGE_ETNA_VIV
	bool "etna_viv"
	depends on !BR2_PTHREADS_NONE
	help
	  User-space driver for the Vivante GCxxx series of embedded GPUs.

	  https://github.com/laanwj/etna_viv

	  Select the ABI version to match the "galcore" driver.

if BR2_PACKAGE_ETNA_VIV

choice
	prompt "Kernel driver ABI version"
	default BR2_PACKAGE_ETNA_VIV_ABIV2

config BR2_PACKAGE_ETNA_VIV_ABIV2
        bool "v2"

config BR2_PACKAGE_ETNA_VIV_ABIV4
        bool "v4"

endchoice

endif
```

## package/fluidsynth/Config.in
```kconfig
config BR2_PACKAGE_FLUIDSYNTH
	bool "fluidsynth"
	select BR2_PACKAGE_LIBGLIB2
	select BR2_PACKAGE_ALSA_LIB_RAWMIDI if BR2_PACKAGE_ALSA_LIB
	help
	  FluidSynth is a real-time software synthesizer based on the SoundFont 2
	  specifications.

	  http://fluidsynth.sourceforge.net/
```

## package/gcw-connect/Config.in
```kconfig
config BR2_PACKAGE_GCW_CONNECT
	bool "GCW Connect"
	depends on BR2_PACKAGE_PYTHON_PYGAME
	select BR2_PACKAGE_PYTHON_PYGAME_FONT
	help
	  This application can be used to configure wireless networks
	  on OpenDingux based systems.

	  https://github.com/skipmeister123/gcwconnect/
```

## package/gmenu2x/Config.in
```kconfig
config BR2_PACKAGE_GMENU2X
	bool "gmenu2x"
	select BR2_PACKAGE_DEJAVU
	select BR2_PACKAGE_LIBPNG
	select BR2_PACKAGE_SDL
	select BR2_PACKAGE_SDL_TTF
	help
	  Application menu for devices with a 320x240 screen and buttons.

	  This is a forked version with cleanups, targeted at the Ben NanoNote
	  and the Dingoo A320/A330.

	  http://projects.qi-hardware.com/index.php/p/gmenu2x

if BR2_PACKAGE_GMENU2X

config BR2_PACKAGE_GMENU2X_PLATFORM
	string "Target platform"

config BR2_PACKAGE_GMENU2X_STICK
	string "stick"
	
config BR2_PACKAGE_GMENU2X_BATTERY
	string "battery"
	
endif
```

## package/gmenu2xm/Config.in
```kconfig
config BR2_PACKAGE_GMENU2XM
	bool "gmenu2xm"
	select BR2_PACKAGE_DEJAVU
	select BR2_PACKAGE_LIBPNG
	select BR2_PACKAGE_SDL
	select BR2_PACKAGE_SDL_TTF
	help
	  Application menu for devices with a 640x480 screen and buttons.

	  This is a forked version with cleanups, targeted at the Ben NanoNote
	  and the Dingoo A320/A330.

	  http://projects.qi-hardware.com/index.php/p/gmenu2x

if BR2_PACKAGE_GMENU2XM

config BR2_PACKAGE_GMENU2XM_PLATFORM
	string "Target platform"

endif
```

## package/gmenunx/Config.in
```kconfig
config BR2_PACKAGE_GMENUNX
	bool "gmenunx"
	select BR2_PACKAGE_DEJAVU
	select BR2_PACKAGE_LIBPNG
	select BR2_PACKAGE_SDL
	select BR2_PACKAGE_SDL_TTF
	help
	  Application menu for devices with a 320x240 screen and buttons.

	  This is a forked version with cleanups, targeted initially at the rg-350

	  https://github.com/podulator/gmenunx

if BR2_PACKAGE_GMENUNX

config BR2_PACKAGE_GMENUNX_PLATFORM
	string "Target platform"

endif
```

## package/hocoslamfy/Config.in
```kconfig
config BR2_PACKAGE_HOCOSLAMFY
	bool "Hocoslamfy"
	select BR2_PACKAGE_SDL
	help
	  Hocoslamfy Game - Rumble Version 
	  https://github.com/jamesofarrell/hocoslamfy/tree/rg350

if BR2_PACKAGE_HOCOSLAMFY

config BR2_PACKAGE_HOCOSLAMFY_PLATFORM
	string "Target platform"
endif 
```

## package/libgbm/Config.in
```kconfig
menuconfig BR2_PACKAGE_LIBGBM
	bool "libgbm"
	depends on BR2_TOOLCHAIN_HAS_THREADS # libpthread-stubs
	select BR2_PACKAGE_LIBPTHREAD_STUBS
	select BR2_PACKAGE_LIBDRM
	select BR2_PACKAGE_LIBDRM_ETNAVIV
	select BR2_PACKAGE_LIBDRM_HAS_ATOMIC
	help
	  Direct Rendering Manager

	  https://git.ti.com/cgit/glsdk/libgbm

comment "libgbm needs a toolchain w/ threads"
	depends on !BR2_TOOLCHAIN_HAS_THREADS
	
comment "libgbm requires udev to be enabled"
	depends on !BR2_PACKAGE_HAS_UDEV
```

## package/libgdiplus/Config.in
```kconfig
config BR2_PACKAGE_LIBGDIPLUS
	bool "libgdiplus"
	select BR2_PACKAGE_CAIRO
	select BR2_PACKAGE_FREETYPE
	help
	  An Open Source implementation of the GDI+ API.

	  http://mono-project.com
```
