## package/libini/Config.in
```kconfig
config BR2_PACKAGE_LIBINI
	bool "libini"
	help
	  Small library to read INI configuration files
```

## package/libmikmod/Config.in
```kconfig
config BR2_PACKAGE_LIBMIKMOD
	bool "libmikmod"
	help
	  libmikmod is a library supporting many formats, including s3m, it, xm,
	  and several others. Mikmod is a module player based on libmikmod.

	  http://mikmod.sourceforge.net/
	  https://sourceforge.net/projects/mikmod/
```

## package/libpng16/Config.in
```kconfig
config BR2_PACKAGE_LIBPNG16
	bool "libpng16"
	select BR2_PACKAGE_ZLIB
	help
	  Library for handling PNG (Portable Network Graphics)
	  images.

	  http://www.libpng.org/
```

## package/libzip/Config.in
```kconfig
config BR2_PACKAGE_LIBZIP
	bool "libzip"
	select BR2_PACKAGE_ZLIB
	help
	  libzip is a C library for reading, creating, and modifying
	  zip archives.

	  http://www.nih.at/libzip/
```

## package/lightning/Config.in
```kconfig
config BR2_PACKAGE_LIGHTNING
	bool "lightning"
	depends on BR2_sparc || BR2_i386 || BR2_x86_64 || BR2_mips || BR2_mipsel || BR2_arm || BR2_powerpc
	help
	  GNU lightning is a library that generates
	  assembly language code at run-time.

	  https://www.gnu.org/software/lightning/
```

## package/lightrec/Config.in
```kconfig
config BR2_PACKAGE_LIGHTREC
	bool "lightrec"
	depends on BR2_sparc || BR2_i386 || BR2_x86_64 || BR2_mips || BR2_mipsel || BR2_arm || BR2_powerpc
	depends on BR2_PACKAGE_LIGHTNING # liblighing
	depends on BR2_PACKAGE_LIBPTHREAD_STUBS # libpthread
	help
	  Lightrec is a MIPS-to-everything dynamic recompiler for PlayStation emulators, using GNU Lightning as the code emitter.
          As such, in theory it should be able to run on every CPU that Lightning can generate code for; including, 
          but not limited to, x86, x86_64, ARM, Aarch64, MIPS, PowerPC and Risc-V.

	  https://github.com/pcercuei/lightrec
```

## package/linux-console-tools/Config.in
```kconfig
config BR2_PACKAGE_LINUX_CONSOLE_TOOLS
	bool "linux-console-tools (for joysticks)"
	help
	  This package contains utilities to calibrate and test joysticks and
	  joypads, to test force feedback and to connect legacy serial devices
	  to the input layer.

	  http://sourceforge.net/projects/linuxconsole/

if BR2_PACKAGE_LINUX_CONSOLE_TOOLS

config BR2_PACKAGE_LINUX_CONSOLE_TOOLS_JOY
	bool "joystick/joypad tools"
	help
	  Install tools to calibrate and test joysticks and joypads.

config BR2_PACKAGE_LINUX_CONSOLE_TOOLS_FF
	bool "force feedback tools"
	help
	  Install tools to test force feedback.

if BR2_PACKAGE_LINUX_CONSOLE_TOOLS_FF
comment "ffmvforce will not be built since it requires SDL"
	depends on !BR2_PACKAGE_SDL
endif

config BR2_PACKAGE_LINUX_CONSOLE_TOOLS_INPUTATTACH
	bool "inputattach tool"
	help
	  Install inputattach, a tool to connect legacy serial devices to the
	  input layer.

endif
```
